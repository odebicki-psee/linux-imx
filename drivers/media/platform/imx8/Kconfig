## drivers/media/platform/imx8/Kconfig
```kconfig
if VIDEO_MX8_CAPTURE
menu "IMX8 Camera ISI/MIPI Features support"

config IMX8_MIPI_CSI2_YAV
	tristate "IMX8 MIPI CSI2 Controller Yet Another Version"
	default y

config IMX8_PSEE_CAPTURE
	tristate "IMX8MQ MIPI driver for Prophesee Gen3 and Gen4 Event Based Camera"
	select IMX8_MIPI_CSI2_YAV
	default y

config IMX8_JPEG
	tristate "IMX8 JPEG Encoder/Decoder"
	depends on VIDEO_V4L2 && VIDEO_V4L2_SUBDEV_API
	select V4L2_MEM2MEM_DEV
	select VIDEOBUF2_DMA_CONTIG
	default m

endmenu
endif #VIDEO_MX8_CAPTURE
```
